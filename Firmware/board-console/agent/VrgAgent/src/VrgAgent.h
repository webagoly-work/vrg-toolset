// VrgAgent.h - Board Console board agent (phase 3a). Header-only Arduino library for ESP32 boards.
//
// Tells the Board Console which firmware runs, which connectors it uses, and the live state of
// the pins it set up. Talks over the sketch's Serial (on the dev board: the COM / UART port, the
// same one the Console flashes through) in short lines that start with '#', so the sketch's own
// output keeps working and shows up in the Console log.
//
// Use (the order matters: board_pins.h first, then this file, then your code):
//
//   #include "board_pins.h"        // optional: generated by the Board Console (VRG_SETUP, VRG_USES, buses)
//   #include <VrgAgent.h>
//   void setup() { Serial.begin(115200); VRG_AGENT_BEGIN("enc_test", "1.1"); ... }
//
// How it knows the pins without changes to the sketch (the gpio_viewer idea): after this header,
// pinMode / digitalWrite / analogRead / ledcAttach / ledcWrite are macros that record the call and
// then call the real function. Buses come from board_pins.h (I2C0_SDA, SPI_MOSI, UART1_TX ...).
//
// Protocol (board -> PC, at most 20 updates a second, only what changed):
//   #HELLO vrg-agent 1 fw=<id> ver=<version> chip=<model> mac=<mac> setup=<name>
//   #USES <connector,connector>            (from VRG_USES; "-" if none)
//   #PINS <gpio>:<mode> ...                 modes: IN IN_PU IN_PD OUT OD PWM ADC I2C SPI UART
//   #P <gpio>=<0|1> ...                     digital levels (inputs read here, outputs as written)
//   #A <gpio>=<0..4095> ...                 analog readings the sketch made
//   #D <gpio>=<duty> ...                    PWM duty the sketch wrote
// PC -> board:
//   ?                                       resend HELLO, USES, PINS and every value
//
// The agent reads Serial in its own task: a sketch that reads Serial itself should not use '?'.

#pragma once
#include <Arduino.h>

#ifndef VRG_AGENT_RATE_HZ
#define VRG_AGENT_RATE_HZ 20
#endif
#ifndef VRG_AGENT_ADC_STEP
#define VRG_AGENT_ADC_STEP 16   // send an analog value again only when it moved this much
#endif

namespace vrg_agent {

enum Mode : uint8_t { M_NONE, M_IN, M_IN_PU, M_IN_PD, M_OUT, M_OD, M_PWM, M_ADC, M_I2C, M_SPI, M_UART };
static const char* const MODE_NAME[] = { "-", "IN", "IN_PU", "IN_PD", "OUT", "OD", "PWM", "ADC", "I2C", "SPI", "UART" };
static const int NPIN = 49;   // GPIO 0..48 (ESP32-S3); the classic ESP32 uses 0..39

struct State {
  uint8_t mode[NPIN];
  int32_t val[NPIN];     // last level / reading / duty
  int32_t sent[NPIN];    // what the Console last got
  bool pinsDirty, full;
  const char* fw;
  const char* ver;
  Stream* io;
  TaskHandle_t task;
};
inline State& st() { static State s = {}; return s; }

inline uint8_t modeOf(uint8_t m) {
#ifdef ANALOG
  if (m == ANALOG) return M_ADC;
#endif
  if (m & 0x02) return (m & 0x10) ? M_OD : M_OUT;   // OUTPUT / OUTPUT_OPEN_DRAIN
  if (m & 0x04) return M_IN_PU;                      // PULLUP
  if (m & 0x08) return M_IN_PD;                      // PULLDOWN
  return M_IN;
}
inline void setMode(int p, uint8_t m) {
  if (p < 0 || p >= NPIN) return;
  State& s = st();
  if (s.mode[p] != m) { s.mode[p] = m; s.sent[p] = INT32_MIN; s.pinsDirty = true; }
}

// ---- the hooks behind the macros: record, then call the real function (the parentheses stop the macro)
inline void hPinMode(uint8_t p, uint8_t m) { (pinMode)(p, m); setMode(p, modeOf(m)); }
inline void hDigitalWrite(uint8_t p, uint8_t v) { (digitalWrite)(p, v); if (p < NPIN) st().val[p] = v ? 1 : 0; }
inline uint16_t hAnalogRead(uint8_t p) {
  uint16_t v = (analogRead)(p);
  if (p < NPIN) { if (st().mode[p] != M_ADC) setMode(p, M_ADC); st().val[p] = v; }
  return v;
}
#if defined(ESP_ARDUINO_VERSION_MAJOR) && ESP_ARDUINO_VERSION_MAJOR >= 3
inline bool hLedcAttach(uint8_t p, uint32_t f, uint8_t r) { bool ok = (ledcAttach)(p, f, r); setMode(p, M_PWM); return ok; }
inline bool hLedcWrite(uint8_t p, uint32_t d) { bool ok = (ledcWrite)(p, d); if (p < NPIN) st().val[p] = (int32_t)d; return ok; }
#endif

// ---- output
inline void line(const char* s) {
  State& g = st();
  if (g.io) { g.io->write((const uint8_t*)s, strlen(s)); g.io->write('\n'); }
}
inline void sendHello() {
  char b[200];
  uint64_t mac = ESP.getEfuseMac();
  uint8_t* m = (uint8_t*)&mac;
#ifdef VRG_SETUP
  const char* setup = VRG_SETUP;
#else
  const char* setup = "-";
#endif
  snprintf(b, sizeof b, "#HELLO vrg-agent 1 fw=%s ver=%s chip=%s mac=%02x:%02x:%02x:%02x:%02x:%02x setup=%s",
           st().fw ? st().fw : "?", st().ver ? st().ver : "?", ESP.getChipModel(), m[0], m[1], m[2], m[3], m[4], m[5], setup);
  for (char* c = strstr(b, "setup=") + 6; *c; ++c) if (*c == ' ') *c = '_';   // keep it one token
  line(b);
#ifdef VRG_USES
  snprintf(b, sizeof b, "#USES %s", VRG_USES);
#else
  snprintf(b, sizeof b, "#USES -");
#endif
  line(b);
}
inline void sendPins() {
  char b[256];
  int n = snprintf(b, sizeof b, "#PINS");
  for (int p = 0; p < NPIN; ++p) if (st().mode[p] != M_NONE) {
    if (n > (int)sizeof b - 16) { line(b); n = snprintf(b, sizeof b, "#PINS"); }
    n += snprintf(b + n, sizeof b - n, " %d:%s", p, MODE_NAME[st().mode[p]]);
  }
  line(b);
  st().pinsDirty = false;
}
// One line per kind with everything that changed since the last time.
inline void sendValues(bool all) {
  State& s = st();
  char bp[256], ba[256], bd[256];
  int np = snprintf(bp, sizeof bp, "#P"), na = snprintf(ba, sizeof ba, "#A"), nd = snprintf(bd, sizeof bd, "#D");
  for (int p = 0; p < NPIN; ++p) {
    uint8_t m = s.mode[p];
    if (m == M_NONE || m == M_I2C || m == M_SPI || m == M_UART) continue;
    int32_t v = s.val[p];
    if (m == M_IN || m == M_IN_PU || m == M_IN_PD) v = s.val[p] = (digitalRead)(p);
    bool changed = all || s.sent[p] == INT32_MIN || (m == M_ADC ? abs(v - s.sent[p]) >= VRG_AGENT_ADC_STEP : v != s.sent[p]);
    if (!changed) continue;
    s.sent[p] = v;
    char* b = m == M_ADC ? ba : m == M_PWM ? bd : bp;
    int& n = m == M_ADC ? na : m == M_PWM ? nd : np;
    if (n > 240) { line(b); n = snprintf(b, 256, "%s", m == M_ADC ? "#A" : m == M_PWM ? "#D" : "#P"); }
    n += snprintf(b + n, 256 - n, " %d=%ld", p, (long)v);
  }
  if (np > 2) line(bp);
  if (na > 2) line(ba);
  if (nd > 2) line(bd);
}

inline void markBuses() {
  auto bus = [](int p, uint8_t m) { if (p >= 0 && p < NPIN && st().mode[p] == M_NONE) setMode(p, m); };
#ifdef I2C0_SDA
  bus(I2C0_SDA, M_I2C); bus(I2C0_SCL, M_I2C);
#endif
#ifdef I2C1_SDA
  bus(I2C1_SDA, M_I2C); bus(I2C1_SCL, M_I2C);
#endif
#ifdef SPI_MOSI
  bus(SPI_MOSI, M_SPI); bus(SPI_SCK, M_SPI); bus(SPI_MISO, M_SPI);
#endif
#ifdef UART1_TX
  bus(UART1_TX, M_UART); bus(UART1_RX, M_UART);
#endif
  (void)bus;
}

inline void taskFn(void*) {
  State& s = st();
  const TickType_t period = pdMS_TO_TICKS(1000 / VRG_AGENT_RATE_HZ);
  TickType_t last = xTaskGetTickCount();
  for (;;) {
    vTaskDelayUntil(&last, period);
    bool ask = false;
    while (s.io && s.io->available()) if (s.io->read() == '?') ask = true;
    if (ask) { sendHello(); s.pinsDirty = true; s.full = true; }
    if (s.pinsDirty) sendPins();
    sendValues(s.full);
    s.full = false;
  }
}

inline void begin(const char* fw, const char* ver, Stream& io = Serial) {
  State& s = st();
  s.fw = fw; s.ver = ver; s.io = &io;
  for (int p = 0; p < NPIN; ++p) s.sent[p] = INT32_MIN;
  markBuses();
  sendHello();
  s.pinsDirty = true; s.full = true;
  if (!s.task) xTaskCreatePinnedToCore(taskFn, "vrgAgent", 4096, nullptr, 1, &s.task, tskNO_AFFINITY);
}

}  // namespace vrg_agent

#define VRG_AGENT_BEGIN(fw, ver) vrg_agent::begin((fw), (ver))

// ---- the traps (after the hooks, so the hooks still reach the real functions)
#define pinMode(p, m) vrg_agent::hPinMode((p), (m))
#define digitalWrite(p, v) vrg_agent::hDigitalWrite((p), (v))
#define analogRead(p) vrg_agent::hAnalogRead((p))
#if defined(ESP_ARDUINO_VERSION_MAJOR) && ESP_ARDUINO_VERSION_MAJOR >= 3
#define ledcAttach(p, f, r) vrg_agent::hLedcAttach((p), (f), (r))
#define ledcWrite(p, d) vrg_agent::hLedcWrite((p), (d))
#endif
